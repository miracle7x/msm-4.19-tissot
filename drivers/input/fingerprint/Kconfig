## drivers/input/fingerprint/Kconfig
```kconfig
source "drivers/input/fingerprint/fpc/Kconfig"
source "drivers/input/fingerprint/fpc_ysl/Kconfig"
source "drivers/input/fingerprint/fpc_rosy/Kconfig"
source "drivers/input/fingerprint/goodix/Kconfig"
source "drivers/input/fingerprint/goodix_ysl/Kconfig"
source "drivers/input/fingerprint/goodix_rosy/Kconfig"
source "drivers/input/fingerprint/goodix_vince/Kconfig"
```

## techpack/Kconfig
```kconfig
menu "Tech packages"

source "techpack/data/Kconfig"
source "techpack/camera-legacy/Kconfig"
source "techpack/camera-legacy-n/Kconfig"

endmenu
```
